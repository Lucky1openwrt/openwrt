// SPDX-License-Identifier: GPL-2.0-or-later OR MIT

#include "mt7621_dlink_dir-xxxx-xx.dtsi"
#include "mt7621_dlink_flash-128m-a1.dtsi"

/ {
	compatible = "dlink,dir-2150-a1", "mediatek,mt7621-soc";
	model = "D-Link DIR-2150 A1";
};
